## arch/arm64/configs/rosemary_defconfig
```kconfig
CONFIG_ARM64=y
CONFIG_ARM64_VA_BITS=39
CONFIG_AEABI=y
CONFIG_COMPAT=y
CONFIG_GNUC_VERSION=11
CONFIG_GCC_VERSION=11
CONFIG_ARM64_CORTEX_A73=y
CONFIG_ARM64_CORTEX_A53=y
CONFIG_HZ=1000
CONFIG_DEFAULT_HZ=1000
CONFIG_DEFAULT_FIRMWARE="mediatek"
CONFIG_ARCH_SUPPORTS_INT128=y
CONFIG_GCC_VERSION=11
CONFIG_ARCH_ENABLE_BTI=y
CONFIG_COMPAT_32BIT=y
CONFIG_PREEMPT=y
CONFIG_SCHED_HRTICK=y
CONFIG_CPU_FREQ_DEFAULT_GOV_PERFORMANCE=y
CONFIG_CPU_FREQ_GOV_ONDEMAND=y
CONFIG_CPU_FREQ_GOV_INTERACTIVE=y
CONFIG_CPU_FREQ_GOV_SCHEDUTIL=y
CONFIG_CPU_FREQ_GOV_POWERSAVE=y
CONFIG_CPU_IDLE=y
CONFIG_CPU_IDLE_GOV_LADDER=y
CONFIG_CPU_IDLE_GOV_MENU=y
CONFIG_CPU_IDLE_GOV_TEO=y
CONFIG_CPU_IDLE_GOV_SMP=y
CONFIG_ARM64_ERRATA_843419=y
CONFIG_ARM64_ERRATA_832075=y
CONFIG_ARM64_ERRATA_1219267=y
CONFIG_ARM64_ERRATA_14840=y
CONFIG_ARM64_ERRATA_17025=y
CONFIG_USB_UAC1=y
CONFIG_USB_UAC2=y
CONFIG_USB_UAC3=y
CONFIG_USB_AUDIO=y
CONFIG_USB_GADGET=y
CONFIG_USB_GADGET_STORAGE=y
CONFIG_USB_MTP=y
CONFIG_USB_PTP=y
CONFIG_USB_MASS_STORAGE=y
CONFIG_USB_STORAGE=y
CONFIG_USB_SUPPORT=y
CONFIG_FAT_FS=y
CONFIG_VFAT_FS=y
CONFIG_EXT4_FS=y
CONFIG_BTRFS_FS=y
CONFIG_XFS_FS=y
CONFIG_NTFS_FS=y
CONFIG_REISERFS_FS=y
CONFIG_F2FS_FS=y
CONFIG_JFS_FS=y
CONFIG_MINIX_FS=y
CONFIG_LVM=y
CONFIG_MD_RAID0=y
CONFIG_MD_RAID1=y
CONFIG_MD_RAID5=y
CONFIG_MD_RAID6=y
CONFIG_MD_RAID10=y
CONFIG_EXT4_FS_XATTR=y
CONFIG_EXT4_FS_POSIX_ACL=y
CONFIG_EXT4_FS_SECURITY=y

CONFIG_F2FS_FS_SECURITY=y
CONFIG_F2FS_FS_XATTR=y
CONFIG_DEFAULT_SECURITY_DAC=y
CONFIG_KALLSYMS=y
CONFIG_DEBUG_INFO=y
CONFIG_PREEMPT_RT_FULL=y
CONFIG_PRINTK_TIME=y
CONFIG_SECURITY_SELINUX=y
CONFIG_SECURITY_YAMA=y
CONFIG_SECURITY_TOMOYO=y
CONFIG_DEFAULT_SECURITY="selinux"
CONFIG_USER_NS=y
CONFIG_UNIX98_PTYS=y
CONFIG_TMPFS=y
CONFIG_UBIFS_FS=y
CONFIG_CGROUPS=y
CONFIG_BLK_DEV_INITRD=y
CONFIG_ATA=y
CONFIG_SATA_AHCI=y
CONFIG_SATA_PMP=y
CONFIG_PATA_ACPI=y
CONFIG_PATA_AMD=y
CONFIG_PATA_MARVELL=y
CONFIG_PATA_PDC2027=y
CONFIG_PATA_PLATFORM=y
CONFIG_PATA_SIS=y
CONFIG_PATA_TRIFLEX=y
CONFIG_PATA_VIA=y
CONFIG_PATA_CS5530=y
CONFIG_PATA_OAK=y

CONFIG_MTK_PLATFORM=y
CONFIG_MTK_USB_SUPPORT=y
CONFIG_MTK_UFS=y
CONFIG_MTK_WATCHDOG=y
CONFIG_MTK_POWER=y
CONFIG_MTK_IOMMU=y
CONFIG_MTK_MCU=y
CONFIG_MTK_FAN=y
CONFIG_MTK_WIFI=y
CONFIG_MTK_BLUETOOTH=y
```
